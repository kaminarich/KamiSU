## kernel/Kconfig
```kconfig
menu "KernelSU"

config KSU
	tristate "KernelSU function support"
	depends on KPROBES
	default y
	help
	  Enable kernel-level root privileges on Android System.
	  Requires CONFIG_KPROBES for kernel hooking support.
	  To compile as a module, choose M here: the
	  module will be called kernelsu.

config KSU_DEBUG
	bool "KernelSU debug mode"
	depends on KSU
	default n
	help
	  Enable KernelSU debug mode.

config KSU_ALLOWLIST_WORKAROUND
	bool "KernelSU Session Keyring Init workaround"
	depends on KSU
	default n
	help
	  Enable session keyring init workaround for problematic devices.
	  Useful for situations where the SU allowlist is not kept after a reboot.

config KSU_MULTI_MANAGER_SUPPORT
	bool "Multi KernelSU manager support"
	depends on KSU
	default n
	help
	  Enable multi KernelSU manager support.
	  When enabled, the following managers are accepted in addition to KamiSU:
	  KowSU, RKSU, SukiSU Ultra, KernelSU-Next, WildKSU, MamboSU,
	  Official KernelSU, ReSukiSU, and a custom build-time hash.
	  Dynamic manager registration via ioctl is always available regardless
	  of this option.

endmenu
```
